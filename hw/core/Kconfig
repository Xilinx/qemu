## hw/core/Kconfig
```kconfig
config EMPTY_SLOT
    bool

config PTIMER
    bool

config FITLOADER
    bool

config PLATFORM_BUS
    bool

config REMOTE_PORT
	bool

config REMOTE_PORT_PCI
	bool
```

## hw/gpio/Kconfig
```kconfig
config MAX7310
    bool
    depends on I2C

config PL061
    bool

config GPIO_KEY
    bool

config XILINX_IOMODULE_GPI
	bool

config XILINX_IOMODULE_GPO
	bool
```

## hw/i3c/Kconfig
```kconfig
config I3C
    bool

config I3C_DEVICES
    # Device group for i3c devices which can reasonably be user-plugged to any
    # board's i3c bus.
    bool

config MOCK_TARGET
    bool
    select I3C
    default y if I3C_DEVICES

config REMOTE_I3C
    bool
    select I3C
    default y if I3C_DEVICES
```

## hw/ssi/Kconfig
```kconfig
config PL022
    bool
    select SSI

config SSI
    bool

config XILINX_SPI
    bool
    select SSI

config XILINX_SPIPS
    bool
    select SSI
    select REGISTER # For xlnx-versal-ospi

config XILINX_AXIQSPI
    bool
    select SSI

config STM32F2XX_SPI
    bool
    select SSI
```
