## hw/crypto/Kconfig
```kconfig
config XLNX_VERSAL2_ASU_AES
    bool
    select XLNX_EFUSE_CRC

config XLNX_SHA3_COMMON
    bool

config XLNX_SPARTANUP_PMC_SHA3
    bool
    select XLNX_SHA3_COMMON

config XLNX_VERSAL2_ASU_SHA
    bool
    select XLNX_SHA3_COMMON

config XLNX_VERSAL2_PMC
    bool
    select XLNX_VERSAL2_ASU_SHA
    select XLNX_VERSAL2_ASU_AES
```
